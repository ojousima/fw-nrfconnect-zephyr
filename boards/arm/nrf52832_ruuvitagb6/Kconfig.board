## boards/arm/nrf52832_ruuvitagb6/Kconfig.board
```kconfig
# Kconfig - nRF52832 RuuviTag B6 board configuration
#
# Copyright (c) 2019 Ruuvi Innovations Ltd
#
# SPDX-License-Identifier: Apache-2.0

config  BOARD_NRF52832_RUUVITAGB6
	bool "nRF52 nRF52832 RUUVITAGB6"
	depends on SOC_NRF52832_QFAA
```

## boards/arm/nrf52832_ruuvitagb6/Kconfig.defconfig
```kconfig
# Kconfig - nRF52832 RuuviTag B6 board configuration
#
# Copyright (c) 2019 Ruuvi Innovations Ltd
#
# SPDX-License-Identifier: Apache-2.0

if BOARD_NRF52832_RUUVITAGB6

config BOARD
	default "nrf52832_ruuvitagb6"

if ADC

config ADC_0
	default y

endif # ADC

if I2C

config I2C_0
	default y

endif # I2C

if PWM

config PWM_0
	default y

endif # PWM

if SPI

config SPI_1
	default y

endif # SPI

config BT_CTLR
	default BT

endif # BOARD_NRF52832_RUUVITAGB6
```
